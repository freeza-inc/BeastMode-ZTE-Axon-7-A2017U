## drivers/clk/msm/Kconfig
```kconfig
config MSM_CLK_CONTROLLER_V2
	bool "QTI clock driver"
	---help---
	   Generate clock data structures from definitions found in
	   device tree.

config PVS_LEVEL_INTERFACE
	bool "Expose PVS level information in sysfs"
	help
		Allow PVS level to be shown in sysfs.

source "drivers/clk/msm/mdss/Kconfig"
```
